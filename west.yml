## west.yml
```yaml
#
# Copyright (C) 2023 Renesas Electronics Corporation.
# Copyright (C) 2023 EPAM Systems, Inc.
#
# SPDX-License-Identifier: Apache-2.0
#

# West YAML manifest for Zephyr as Xen Dom0

manifest:
  self:
    path: aos_core_zephyr

  remotes:
    - name: xen-troops
      url-base: https://github.com/xen-troops

    - name: aoscloud
      url-base: https://github.com/aoscloud

    - name: zephyrproject-rtos
      url-base: https://github.com/zephyrproject-rtos

    - name: ddone
      url-base: https://github.com/Deedone

  projects:
    - name: zephyr
      # remote: xen-troops
      # revision: "b1ab92967739d06599231d0ee4f4c8d68a6681b0"
      remote: ddone
      revision: "zephyr-v3.6.0-xt-v7"
      west-commands: scripts/west-commands.yml

    - name: aos_core_lib_cpp
      remote: aoscloud
      revision: "v0.2.2"

    - name: aos_core_api
      remote: aoscloud
      revision: "v7.2.2"

    - name: zephyr-xenlib
      # remote: xen-troops
      # revision: "f93f5d6b59ce9c39b1a8ef980530dc5ae372c93f"
      remote: ddone
      revision: "wip_zephyr_3.6-v2"

    - name: zephyr-optee-client
      remote: ddone
      revision: "wip_zephyr_3.6-v1"

    - name: littlefs
      remote: zephyrproject-rtos
      revision: "ca583fd297ceb48bced3c2548600dc615d67af24"
      path: modules/fs/littlefs
      groups:
        - fs

    - name: nanopb
      remote: zephyrproject-rtos
      revision: "42fa8b211e946b90b9d968523fce7b1cfe27617e"
      path: modules/lib/nanopb

    - name: tinycrypt
      remote: zephyrproject-rtos
      revision: "3e9a49d2672ec01435ffbf0d788db6d95ef28de0"
      path: modules/crypto/tinycrypt
      groups:
        - crypto
```
